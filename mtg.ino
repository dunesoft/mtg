#include <Arduboy2.h>
Arduboy2 arduboy;

//A simple "Magic The Gathering" life counter, helps keep track of life totals. Right + Left to reset.

const unsigned char mtglogo[] PROGMEM  = {
  //width = 58, height = 58
  0x00, 0x00, 0x00, 0x00, 0x00, 0x00, 0x00, 0x00, 0x00, 0x00, 0x00, 0x00, 0x80, 0x80, 0xc0, 0xe0, 
  0xe0, 0xf0, 0xf0, 0xf8, 0xf8, 0xf8, 0xfc, 0xfc, 0xfc, 0xfc, 0xfc, 0xfc, 0xfc, 0xfc, 0xfc, 0xfc, 
  0xfc, 0xfc, 0xfc, 0xf8, 0xf8, 0xf8, 0xf8, 0xf0, 0xf0, 0xe0, 0xe0, 0xc0, 0x80, 0x80, 0x00, 0x00, 
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  0x00, 0x00, 0x00, 0x00, 0x00, 0x00, 0x00, 0x00, 0x00, 0x00, 0x00, 0x00, 0x00, 0x00, 0x00, 0x00, 
};


int p1 = 20;
int p2 = 20;

void setup() {
    arduboy.begin();
    arduboy.clear();
    
    arduboy.setCursor(1,5);
    arduboy.setTextSize(1);
    arduboy.print("Player 1");
    
    arduboy.setCursor(80,5);
    arduboy.setTextSize(1);
    arduboy.print("Player 2");

    arduboy.drawBitmap(35, 8, mtglogo, 58, 58, WHITE);

    arduboy.display();
    
}



       
void loop() {

 arduboy.pollButtons();

 if (arduboy.justPressed(RIGHT_BUTTON)) 
  p1 = (p1 + 1);
  arduboy.setCursor(1,25);
  arduboy.setTextSize(3);
  arduboy.print("  ");


 if (arduboy.justPressed(LEFT_BUTTON)) {
  if (p1 > 0) {
    p1 = (p1 - 1);
    arduboy.setCursor(1,25);
    arduboy.setTextSize(3);
    arduboy.print("  ");

    }
 }

if (arduboy.justPressed(A_BUTTON)) 
  p2 = (p2 + 1);
  arduboy.setCursor(95,25);
  arduboy.setTextSize(3);
  arduboy.print("  ");

 if (arduboy.justPressed(B_BUTTON)) {
  if (p2 > 0) {
    p2 = (p2 - 1);
    arduboy.setCursor(95,25);
    arduboy.setTextSize(3);
    arduboy.print("  ");

    }
 }

  if (arduboy.justPressed(UP_BUTTON) and arduboy.justPressed(DOWN_BUTTON)){
    p1 = 20;
    p2 = 20;
  }
 
 arduboy.setCursor(1,25);
 arduboy.setTextSize(3);
 arduboy.print(p1);

 arduboy.setCursor(95,25);
 arduboy.setTextSize(3);
 arduboy.print(p2);
 
    
 arduboy.display();
 
 arduboy.delayShort(100);

}
